/dts-v1/;
/plugin/;

/ {
    compatible = "allwinner,sun4i-a10", "allwinner,sun7i-a20", "allwinner,sun8i-h3", "allwinner,sun50i-a64", "allwinner,sun50i-h5";

    fragment@0{
        target = <&spi1>;
        status = "okay";
        __overlay__{
            #address-cells = <1>;
            #size-cells = <0>;
            temp-sensor@1{
                compatible = "maxim,max6675";
                reg = <0>;
                spi-max-frequency = <4300000>;
                spi-cpha;
            };
        };
    };
};